# TEST register map
Vendor: rttsh test
ST-style minimal fixture: device-level property inheritance and the field-fallback defense path
CPU: CM4 r0p1, little endian, no MPU, FPU, 4 interrupt priority bits
Registers are 32-bit, read-write, reset 0x12345678 unless marked. A register's access mark holds for its fields unless they carry their own. Offsets are from the block's base; lines under a group give offsets from that group; [hi:lo] are bit positions; {n}, {i} and the like mark numbered series; 'fields as' and 'values as' point back to an identical list; <NAME> marks a mode.

## Memory map
0x40003000 P — Inheritance unit

## P — Inheritance unit
Base 0x40003000
0x00 R1 — Inherits the device resetValue; no own access/size
  [1:0] F1
0x04 R2 read-clears — Clear-on-read register whose field carries no own properties
  [0] F2
