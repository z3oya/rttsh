# TEST register map
Vendor: rttsh test
ST-style minimal fixture: write-only access
CPU: CM4 r0p1, little endian, no MPU, FPU, 4 interrupt priority bits
Registers are 32-bit, write-only, reset 0x0 unless marked. A register's access mark holds for its fields unless they carry their own. Offsets are from the block's base; lines under a group give offsets from that group; [hi:lo] are bit positions; {n}, {i} and the like mark numbered series; 'fields as' and 'values as' point back to an identical list; <NAME> marks a mode.

## Memory map
0x40001000 WO — Unit with a write-only register

## WO — Unit with a write-only register
Base 0x40001000
0x00 TX — Transmit data
  [7:0] DATAW
0x04 RX ro — Receive data
  [7:0] DATAR
