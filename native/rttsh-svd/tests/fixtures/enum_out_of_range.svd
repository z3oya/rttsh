# TEST register map
Vendor: rttsh test
ST-style minimal fixture: enum value out of field range (U575 SMS1 shape). Intentionally fails ValidateLevel::Weak; the ladder must load it relaxed.
CPU: CM4 r0p1, little endian, no MPU, FPU, 4 interrupt priority bits
Registers are 32-bit, read-write, reset 0x0 unless marked. A register's access mark holds for its fields unless they carry their own. Offsets are from the block's base; lines under a group give offsets from that group; [hi:lo] are bit positions; {n}, {i} and the like mark numbered series; 'fields as' and 'values as' point back to an identical list; <NAME> marks a mode.

## Memory map
0x40002000 TIM — Timer

## TIM — Timer
Base 0x40002000
0x00 SMCR — Slave mode control
  [2:0] SMS1 — Slave mode selection
    0=ZERO (Zero mode); 1=ONE (One mode); 8=EIGHT (Out of range)
