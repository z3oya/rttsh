# TEST register map
Vendor: rttsh test
ST-style minimal fixture: peripheral derivedFrom
CPU: CM4 r0p1, little endian, no MPU, FPU, 4 interrupt priority bits
Registers are 32-bit, read-write, reset 0x44444444 unless marked. A register's access mark holds for its fields unless they carry their own. Offsets are from the block's base; lines under a group give offsets from that group; [hi:lo] are bit positions; {n}, {i} and the like mark numbered series; 'fields as' and 'values as' point back to an identical list; <NAME> marks a mode.

## Memory map
0x40010800 GPIOA — GPIO port A
0x40010C00 GPIOB

## GPIOA — GPIO port A
Base 0x40010800
Same registers: GPIOB 0x40010C00
0x00 CRL — Port configuration register low
  [1:0] MODE0 — Port mode
    0=INPUT (Input mode); 1=OUTPUT (General purpose output)
0x08 IDR reset 0x0 — Port input data register
  [0] ID0 — Port input data
