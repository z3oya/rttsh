# TEST register map
Vendor: rttsh test
ST-style minimal fixture: both file-bug shapes at once (dangling derivedFrom AND an out-of-range enum value). The ladder must strip SEC_X and load the rest relaxed.
CPU: CM4 r0p1, little endian, no MPU, FPU, 4 interrupt priority bits
Registers are 32-bit, read-write, reset 0x0 unless marked. A register's access mark holds for its fields unless they carry their own. Offsets are from the block's base; lines under a group give offsets from that group; [hi:lo] are bit positions; {n}, {i} and the like mark numbered series; 'fields as' and 'values as' point back to an identical list; <NAME> marks a mode.

## Memory map
0x40002000 TIM — Timer with an out-of-range enum
0x40010800 GPIOA — GPIO port A
0x50000000 SEC_X

## GPIOA — GPIO port A
Base 0x40010800
0x00 CRL

## TIM — Timer with an out-of-range enum
Base 0x40002000
0x00 SMCR — Slave mode control
  [2:0] SMS1 — Slave mode selection
    0=ZERO (Zero mode); 8=EIGHT (Out of range)
